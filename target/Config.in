## target/Config.in
```kconfig
# SPDX-License-Identifier: GPL-2.0-only
#
# Copyright (C) 2006-2013 OpenWrt.org

mainmenu "LEDE Configuration"

config MODULES
    bool
    default y

config HAVE_DOT_CONFIG
    bool
    default y

HOST_OS := $(shell uname)

config HOST_OS_LINUX
    def_bool $(shell ./config/check-uname.sh Linux)

config HOST_OS_MACOS
    def_bool $(shell ./config/check-uname.sh Darwin)

# 包含其他配置文件
source "target/Config.in"
source "config/Config-images.in"
source "config/Config-build.in"
source "config/Config-devel.in"
source "toolchain/Config.in"
source "target/imagebuilder/Config.in"
source "target/sdk/Config.in"
source "target/toolchain/Config.in"
source "tmp/.config-package.in"

# Qualcomm Atheros IPQ60xx系列硬件支持
config TARGET_ipq60xx
    bool "Qualcomm Atheros IPQ60xx"
    select TOOLCHAIN_GCC_ATOMIC
    select TARGET_qualcommax
    select PACKAGE_kernel
    help
      Support for IPQ60xx series platform (including JDCloud RE-CS-02).

config TARGET_qualcommax
    bool "Qualcomm Max"
    default y
    help
      Qualcomm Atheros IPQ60xx (Max) platform support for devices like JDCloud RE-CS-02.

# Architecture selection
config aarch64
    select ARCH_64BIT
    bool
```
